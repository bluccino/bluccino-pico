## CMakeLists.txt
```
# SPDX-License-Identifier: Apache-2.0

cmake_minimum_required(VERSION 3.20.0)
find_package(Zephyr REQUIRED HINTS $ENV{ZEPHYR_BASE})

project(00-empty)
add_definitions(-DPROJECT="${CMAKE_PROJECT_NAME}")

set (PICO ../../../include/zephyr)
include_directories(src ${PICO})
target_sources(app PRIVATE src/main.c)
```

## prj.conf
```kconfig
# no configs
```

## src/main.c
```c
// 00-empty

int main(void)
{
  return 0;
}
```
