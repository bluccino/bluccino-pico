// nrf52840dongle_nrf52840.overlay
// to enable logging via USB console

/ {
	  chosen {
		  zephyr,console = &cdc_acm_uart0;
	  };
  };

  &zephyr_udc0 {
	  cdc_acm_uart0: cdc_acm_uart0 {
		  compatible = "zephyr,cdc-acm-uart";
		  label = "CDC_ACM_0";
	  };
  };
