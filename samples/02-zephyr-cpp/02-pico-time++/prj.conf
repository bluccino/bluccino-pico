## CMakeLists.txt
```
# SPDX-License-Identifier: Apache-2.0

cmake_minimum_required(VERSION 3.20.0)
find_package(Zephyr REQUIRED HINTS $ENV{ZEPHYR_BASE})

project(02-pico-time++)
add_definitions(-DPROJECT="${CMAKE_PROJECT_NAME}")

set (PICO ../../../include/zephyr)
include_directories(src ${PICO})
target_sources(app PRIVATE src/main.cpp)
```

## prj.conf
```kconfig
# configure for C++
CONFIG_CPLUSPLUS=y
```

## src/main.cpp
```c
// main.cpp 02-pico-time++
#include "pico/api.h"

Pico pico;  // create Pico class instance

int main(void)
{
  pico.prt(PI_R PROJECT " (%s)\n" PI_0,CONFIG_BOARD);

	for (PI_ms time=0;;time+=1010)
  {
    pico.sleep(time-pi_ms()-1);   // sleep 1 ms less
    while(pico.us() < 1000*time); // busy wait

    int min,s,ms,us;
    pico.now(&min,&s,& ms,&us);
    pico.prt(PI_Y"time: " PI_0 "[%d:%02d:%03d.%03d]\n",
             min,s,ms,us);
  }
}
```
