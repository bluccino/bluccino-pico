## samples/02-zephyr-cpp/01-pico-console++/boards/nrf52840dongle_nrf52840.conf
```kconfig
# nrf52840dongle_nrf52840.conf

#config USB/COM
CONFIG_USB_DEVICE_STACK=y
CONFIG_USB_DEVICE_PRODUCT="Dongle USB"
CONFIG_USB_DEVICE_PID=0x00
CONFIG_USB_DEVICE_VID=0x00

#config console
CONFIG_SERIAL=y
CONFIG_CONSOLE=y
CONFIG_UART_CONSOLE=y
CONFIG_UART_LINE_CTRL=y
```

## samples/04-zephyr-cpp/03-pico-log++/boards/nrf52dk_nrf52832.conf
```kconfig
# nrf52dk_nrf52832.conf / nrf52840dk_nrf52840.conf

# config Segger RTT
CONFIG_UART_CONSOLE=n
CONFIG_USE_SEGGER_RTT=y
CONFIG_RTT_CONSOLE=y
```

## study/03-console/01-console-ready/boards/nrf52840dongle_nrf52840.conf
```kconfig
# on nrf52840dongle_nrf52840 boards we have to configure USB/COM

CONFIG_USB_DEVICE_STACK=y
CONFIG_USB_DEVICE_PRODUCT="Dongle USB"
CONFIG_USB_DEVICE_PID=0x00
CONFIG_USB_DEVICE_VID=0x00

CONFIG_SERIAL=y
CONFIG_CONSOLE=y
CONFIG_UART_CONSOLE=y
CONFIG_UART_LINE_CTRL=y
```
